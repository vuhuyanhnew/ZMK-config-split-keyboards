## config/boards/arm/mytom/Kconfig.board
```kconfig
# Copyright (c) 2021 The ZMK Contributors
# SPDX-License-Identifier: MIT

config BOARD_MYTOM_V1
	bool "mytom v1"
	depends on SOC_NRF52840_QIAA
```

## config/boards/arm/mytom/Kconfig.defconfig
```kconfig
# Copyright (c) 2021 The ZMK Contributors
# SPDX-License-Identifier: MIT

if BOARD_MYTOM_V1_LEFT
    config ZMK_KEYBOARD_NAME 
	default "Mytom Left v1"

config ZMK_SPLIT_ROLE_CENTRAL
	default y
	
if ZMK_DISPLAY

config I2C
	default y

config SSD1306
	default y

config SSD1306_REVERSE_MODE
	default y

config LVGL_HOR_RES_MAX
	default 128

config LVGL_VER_RES_MAX
	default 64

config LVGL_VDB_SIZE
	default 64

config LVGL_DPI
	default 148

config LVGL_BITS_PER_PIXEL
	default 1

choice LVGL_COLOR_DEPTH
	default LVGL_COLOR_DEPTH_1
endchoice

endif # ZMK_DISPLAY

endif #BOARD_MYTOM_V1_LEFT

if BOARD_MYTOM_V1_RIGHT
    config ZMK_KEYBOARD_NAME
	default "Mytom Right v1"
endif #BOARD_MYTOM_V1_RIGHT


if BOARD_MYTOM_V1_LEFT || BOARD_MYTOM_V1_RIGHT

config BOARD
	default "Mytom"

config ZMK_SPLIT
	default y

if USB

config USB_NRFX
	default y

config USB_DEVICE_STACK
	default y

endif # USB

config BT_CTLR
	default BT

config ZMK_BLE
	default y

config ZMK_USB
	default y

config ZMK_BATTERY_VOLTAGE_DIVIDER
	default y

endif 
```

## config/boards/arm/mytom_v1/Kconfig
```kconfig
# SPDX-License-Identifier: MIT

config BOARD_ENABLE_DCDC
	bool "Enable DCDC mode"
	select SOC_DCDC_NRF52X
	default y
	depends on (BOARD_MYTOM_V1_LEFT || BOARD_MYTOM_V1_RIGHT)
```

## config/boards/arm/mytom_v1/Kconfig.board
```kconfig
# Copyright (c) 2021 The ZMK Contributors
# SPDX-License-Identifier: MIT

config BOARD_MYTOM_V1_LEFT
	bool "mytom v1 left"
	depends on SOC_NRF52840_QIAA
config BOARD_MYTOM_V1_RIGHT 
    bool "mytom v1 right"
	depends on SOC_NRF52840_QIAA
```

## config/boards/arm/mytom_v1/Kconfig.defconfig
```kconfig
# Copyright (c) 2021 The ZMK Contributors
# SPDX-License-Identifier: MIT

config
  SOC_SERIES_NRF52X
  default y
config
  SOC_NRF52840_QIAA
  default y

# Enable MPU
config
  ARM_MPU
  default y

# enable GPIO
config
  GPIO
  default y

config
  USE_DT_CODE_PARTITION
  default y

config
  MPU_ALLOW_FLASH_WRITE
  default y
  
config
  NVS
  default y

config
  SETTINGS_NVS
  default y

config
  FLASH
  default y

config
  FLASH_PAGE_LAYOUT
  default y

config
  FLASH_MAP
  default y

config
  BUILD_OUTPUT_UF2
  default y

if BOARD_MYTOM_V1_LEFT
    config ZMK_KEYBOARD_NAME 
	default "Mytom Left v1"

config ZMK_SPLIT_ROLE_CENTRAL
	default y
	
if ZMK_DISPLAY

config I2C
	default y

config SSD1306
	default y

config SSD1306_REVERSE_MODE
	default y

config LVGL_HOR_RES_MAX
	default 128

config LVGL_VER_RES_MAX
	default 64

config LVGL_VDB_SIZE
	default 64

config LVGL_DPI
	default 148

config LVGL_BITS_PER_PIXEL
	default 1

choice LVGL_COLOR_DEPTH
	default LVGL_COLOR_DEPTH_1
endchoice

endif # ZMK_DISPLAY

endif #BOARD_MYTOM_V1_LEFT

if BOARD_MYTOM_V1_RIGHT
    config ZMK_KEYBOARD_NAME
	default "Mytom Right v1"
endif #BOARD_MYTOM_V1_RIGHT


if BOARD_MYTOM_V1_LEFT || BOARD_MYTOM_V1_RIGHT

config BOARD
	default "Mytom"

config ZMK_SPLIT
	default y

if USB

config USB_NRFX
	default y

config USB_DEVICE_STACK
	default y

endif # USB

config BT_CTLR
	default BT

config ZMK_BLE
	default y

config ZMK_USB
	default y

config ZMK_BATTERY_VOLTAGE_DIVIDER
	default y

endif 
```

## config/boards/arm/mytom_v1/mytom_v1_left_defconfig
```kconfig
# Copyright (c) 2021 The ZMK Contributors
# SPDX-License-Identifier: MIT

CONFIG_BOARD_MYTOM_V1_LEFT=y

# RGB
CONFIG_ZMK_RGB_UNDERGLOW=y
CONFIG_WS2812_STRIP=y
CONFIG_ZMK_RGB_UNDERGLOW_EXT_POWER=n
CONFIG_ZMK_RGB_UNDERGLOW_ON_START=n

CONFIG_ZMK_DISPLAY=y

# enable deep sleep support
#CONFIG_ZMK_SLEEP=y
#CONFIG_ZMK_IDLE_SLEEP_TIMEOUT=900000
```

## config/boards/arm/nemm/Kconfig
```kconfig
config BOARD_ENABLE_DCDC
	bool "Enable DCDC mode"
	select SOC_DCDC_NRF52X
	default y
	depends on (BOARD_NEMM_V1_LEFT || BOARD_NEMM_V1_RIGHT)
	
if ZMK_DISPLAY

menuconfig WIDGET_LUNA_STATUS
    bool "widget for displaying luna dog"
    depends on !ZMK_SPLIT || ZMK_SPLIT_ROLE_CENTRAL
    select LVGL_USE_IMG
    select LVGL_USE_ANIMATION
    select ZMK_WPM

if WIDGET_LUNA_STATUS

config ZMK_WIDGET_LUNA_WIDGET_WALK_WPM
    int "Lower limit for WPM for luna to start walking"
    default 10

config ZMK_WIDGET_LUNA_WIDGET_RUN_WPM
    int "Lower limit for WPM for luna to start running"
    default 40

config ZMK_WIDGET_LUNA_WIDGET_FRAME_DURATION
    int "Luna animation frame duration"
    default 200
endif # ZAPHOD_BONGO_CAT


endif
```

## config/boards/arm/nemm/Kconfig.board
```kconfig
 # Nemm v1 board configuration
 # Copyright (c) 2022 kien242
 #
 # SPDX-License-Identifier: MIT

config BOARD_NEMM_V1_LEFT
	bool "nemm_v1_left"
	depends on SOC_NRF52840_QIAA

config BOARD_NEMM_V1_RIGHT
	bool "nemm_v1_right"
	depends on SOC_NRF52840_QIAA
```

## config/boards/arm/nemm/Kconfig.defconfig
```kconfig
 # Copyright (c) 2022 kien242
 #
 # SPDX-License-Identifier: MIT

if BOARD_NEMM_V1_LEFT

	config ZMK_KEYBOARD_NAME
	default "Nemm v1 "

choice ZMK_DISPLAY_STATUS_SCREEN
	default ZMK_DISPLAY_STATUS_SCREEN_CUSTOM
endchoice

if ZMK_DISPLAY

config I2C
	default y

config SSD1306
	default y

config SSD1306_REVERSE_MODE
	default y

config LVGL_HOR_RES_MAX
	default 128

config LVGL_VER_RES_MAX
	default 32

config LVGL_VDB_SIZE
	default 64

config LVGL_DPI
	default 148

config LVGL_BITS_PER_PIXEL
	default 1

choice LVGL_COLOR_DEPTH
	default LVGL_COLOR_DEPTH_1
endchoice

endif # ZMK_DISPLAY
endif # BOARD_NEMM_V1_LEFT

if BOARD_NEMM_V1_RIGHT

	config ZMK_KEYBOARD_NAME
	default "Nemm v1 (right)"

endif # BOARD_NEMM_V1_RIGHT


if BOARD_NEMM_V1_LEFT || BOARD_NEMM_V1_RIGHT

config BOARD
	default "nemm"

config ZMK_SPLIT
	default y

config BT_CTLR
	default BT

config ZMK_BLE
	default y

config ZMK_USB
	default y

config ZMK_BATTERY_VOLTAGE_DIVIDER
	default y

if USB

config USB_NRFX
	default y

config USB_DEVICE_STACK
	default y

endif # USB

endif # BOARD_NEMM_V1_LEFT || BOARD_NEMM_V1_RIGHT
```

## config/boards/arm/noru64/Kconfig.board
```kconfig
# SP56 board configuration

# Copyright (c) 2022 kien242
# SPDX-License-Identifier: MIT

config BOARD_NORU64_V1_LEFT
	bool "noru64_v1_left"
	depends on SOC_NRF52840_QIAA

config BOARD_NORU64_V1_RIGHT
	bool "noru64_v1_right"
	depends on SOC_NRF52840_QIAA
```

## config/west.yml
```yaml
manifest:
  remotes:
    - name: zmkfirmware
      url-base: https://github.com/zmkfirmware
    - name: kien242
      url-base: https://github.com/kien242
    - name: zmkfirmware-infused-kim
      url-base: https://github.com/infused-kim
    - name: zmkfirmware-split-battery-report
      url-base: https://github.com/Katona/
    - name: luna
      url-base: https://github.com/pitchayath/
  projects:
    - name: zmk
      remote: zmkfirmware
      revision: main

      #remote: zmkfirmware-infused-kim
      #revision: my-changes/oled-ext-pwr

      #remote: zmkfirmware-split-battery-report
      #revision: split_battery_service

      #remote: luna
      #revision: luna
      
      import: app/west.yml
  self:
    path: config
```
